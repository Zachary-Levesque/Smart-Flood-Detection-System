## firmware/sdkconfig.defaults
```kconfig
# Default project configuration overrides.
# Run `idf.py menuconfig` to adjust further; this file seeds sane
# defaults for a WiFi-connected sensor node.

CONFIG_ESP_WIFI_STATIC_RX_BUFFER_NUM=10
CONFIG_ESP_WIFI_DYNAMIC_RX_BUFFER_NUM=32
CONFIG_ESP_WIFI_DYNAMIC_TX_BUFFER_NUM=32

CONFIG_FREERTOS_HZ=1000
CONFIG_MBEDTLS_CERTIFICATE_BUNDLE=y
```
